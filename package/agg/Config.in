## package/agg/Config.in
```kconfig
config BR2_PACKAGE_AGG
	bool "agg"
	default n
	help
	  A High Quality Rendering Engine for C++

	  http://www.antigrain.com
```

## package/boost/Config.in
```kconfig
config BR2_PACKAGE_BOOST
	bool "boost"
	default n
	help
	  free peer-reviewed portable C++ source libraries

	  http://voxel.dl.sourceforge.net/sourceforge/boost
```

## package/ca-certificates/Config.in
```kconfig
config BR2_PACKAGE_CA_CERTIFICATES
	bool "ssl certificates"
	default n
	help
	  SSL certificates for OpenSSL
```

## package/cellwriter/Config.in
```kconfig
config BR2_PACKAGE_CELLWRITER
	bool "cellwriter"
	depends on BR2_PACKAGE_LIBGTK2
	help
	  CellWriter is a grid-entry natural handwriting input panel

	  http://pub.risujin.org/latest.php?cellwriter
```

## package/database/Config.in
```kconfig
menu "Database"
source "package/database/mysql/Config.in"
source "package/database/sqlite/Config.in"
endmenu
```

## package/database/mysql/Config.in
```kconfig
config BR2_PACKAGE_MYSQL
	bool "MySQL 5.1 client"
	help
	  MySQL client

config BR2_PACKAGE_MYSQL_SERVER
	bool "MySQL 5.1 server"
	depends on BR2_PACKAGE_MYSQL
	help
	  MySQL server
```

## package/games/fceultra/Config.in
```kconfig
config BR2_PACKAGE_FCEULTRA
	bool "fceultra"
	default n
	help
	  Nintendo NES emulator

	  http://internap.dl.sourceforge.net/sourceforge/fceultra
```

## package/games/stella/Config.in
```kconfig
config BR2_PACKAGE_STELLA
	bool "stella"
	help
	  Atari 2600 VCS emulator

	  http://superb-west.dl.sourceforge.net/sourceforge/stella
```

## package/gnash/Config.in
```kconfig
config BR2_PACKAGE_GNASH
	bool "gnash"
	default n
	help
	  Opensource flash player

	  ftp://ftp.cise.ufl.edu/pub/mirrors/GNU/gnu/gnash/0.8.3
```

## package/gpm/Config.in
```kconfig
config BR2_PACKAGE_GPM
	bool "gpm"
	help
	  GPM (General Purpose Mouse) is a mouse server

	  http://launchpad.net/gpm/main/1.99.7/+download
```

## package/libertas-tools/Config.in
```kconfig
config BR2_PACKAGE_LIBERTAS_TOOLS
	bool "libertas-tools"
	default n
	help
	  tools for using and troubleshooting 
	  libertas wireless drivers

	  git://git.infradead.org/users/schurig
```

## package/lynx/Config.in
```kconfig
config BR2_PACKAGE_LYNX
	bool "lynx"
	help
	  Lynx is the text web browser

	  ftp://lynx.isc.org/lynx2.8.6
```

## package/multimedia/ampache/Config.in
```kconfig
config BR2_PACKAGE_AMPACHE
	bool "ampache"
	select BR2_PACKAGE_PHP
	select BR2_PACKAGE_PHP_CGI
	select BR2_PACKAGE_PHP_EXT_PDO_MYSQL
	select BR2_PACKAGE_MYSQL
	select BR2_PACKAGE_LIGHTTPD

	help
	  Ampache is a Web-based Audio file manager.

	  http://ampache.org
```

## target/device/Atmel/Config.in
```kconfig
menuconfig BR2_TARGET_ATMEL
	bool "Atmel Device Support"
	depends on BR2_avr32

if BR2_TARGET_ATMEL

source "target/device/Atmel/AVR32_Config.in"

config BR2_BOARD_NAME
	string
	default	"atstk100x"		if	BR2_TARGET_AVR32_ATSTK1002
	default	"atstk1005"		if	BR2_TARGET_AVR32_ATSTK1005
	default	"atngw100"		if	BR2_TARGET_AVR32_ATNGW100
	default "atngw100-base"		if	BR2_TARGET_AVR32_ATNGW100_BASE
	default "atngw100-expanded"	if	BR2_TARGET_AVR32_ATNGW100_EXPANDED

comment "Package support"
	depends on BR2_TARGET_AVR32

menu "Secondary locations"

config BR2_TARGET_ATMEL_COPYTO
	string "also copy the image to..."
	depends on BR2_TARGET_AVR32
	default "/tftpboot"
	help
	  Copies the resulting image to a secondary location.

config BR2_BOARD_PATH
	string "Atmel board repository"
	depends on BR2_TARGET_AVR32
	default "target/device/Atmel/$(BR2_BOARD_NAME)"
	help
	  Top directory of Atmel board configurations
endmenu

source "target/device/Atmel/DataFlashBoot/Config.in"

endif
```

## target/device/Config.in
```kconfig
menu "Target options"

source "project/Config.in"

comment "Preset Devices"

source "target/device/Atmel/Config.in"
source "target/device/SpO2_monitor/Config.in"
source "target/device/valka/Config.in"
source "target/device/x86/Config.in"

# This must be last
source "target/generic/Config.in"

endmenu
```

## target/device/SpO2_monitor/Config.in
```kconfig
menuconfig BR2_TARGET_SPO2
	bool "SpO2 monitor"
	depends on BR2_avr32

if BR2_TARGET_SPO2

choice
	prompt "Monitor board"
	depends on BR2_TARGET_SPO2
	help
	  SpO2 Board to build for

config BR2_TARGET_DX4100_1119
	bool "DX4100-1119 (Based on NGW100)"
	depends on BR2_TARGET_SPO2
	help
	  Board based on NGW100

endchoice

config BR2_BOARD_PATH
	string
	default "target/device/SpO2_monitor"	if	BR2_TARGET_SPO2

config BR2_BOARD_NAME
	string
	default "DX4100-1119"	if	BR2_TARGET_DX4100_1119

endif
```

## toolchain/binutils/Config.in
```kconfig
# Choose binutils version.

comment "Binutils Options"

choice
	prompt "Binutils Version"
	default BR2_BINUTILS_VERSION_2_18
	help
	  Select the version of binutils you wish to use.

	config BR2_BINUTILS_VERSION_2_18
		depends on BR2_EXT_BINUTILS_VERSION_2_18
		bool "binutils 2.18"
endchoice

config BR2_BINUTILS_VERSION
	string
	default "2.18"		if BR2_BINUTILS_VERSION_2_18

config BR2_EXTRA_BINUTILS_CONFIG_OPTIONS
	string "Additional binutils options"
	default ""
	help
	  Any additional binutils options you may want to include.
```

## toolchain/gcc/Config.in
```kconfig
# Choose gcc version.

comment "GCC Options"

choice
	prompt "GCC compiler Version"
	default BR2_GCC_VERSION_4_2_2 if BR2_avr32
	help
	  Select the version of gcc you wish to use.

	config BR2_GCC_VERSION_4_1_2
		depends on BR2_DEPRECATED
		bool "gcc 4.1.2"

	config BR2_GCC_VERSION_4_2_2
		depends on BR2_EXT_GCC_VERSION_4_2_2
		depends on BR2_DEPRECATED || BR2_avr32
		bool "gcc 4.2.2"
endchoice

config BR2_GCC_SUPPORTS_SYSROOT
	bool
	default n if BR2_GCC_VERSION_4_1_2
	default y if !BR2_GCC_VERSION_4_1_2

config BR2_GCC_SUPPORTS_FINEGRAINEDMTUNE
	bool
	default n if BR2_GCC_VERSION_4_1_2  || BR2_GCC_VERSION_4_2_2
	default y if !BR2_GCC_VERSION_4_1_2 && !BR2_GCC_VERSION_4_2_2

config BR2_GCC_VERSION
	string
	default "4.1.2"     if BR2_GCC_VERSION_4_1_2
	default "4.2.2"     if BR2_GCC_VERSION_4_2_2

config BR2_TOOLCHAIN_SYSROOT
	bool "Enable toolchain with --sysroot support"
	depends on BR2_GCC_SUPPORTS_SYSROOT
	default y
	help
	  Enables --sysroot=dir for binutils and gcc.
	  Use dir as the logical root directory for headers and libraries.
	  For example, if the compiler would normally search for headers in
	  /usr/include and libraries in /usr/lib, it will instead search
	  dir/usr/include and dir/usr/lib.

	  This does not work with gcc < 4.2.0 (4.1.2 gets
	  ORIGINAL_AS_FOR_TARGET wrong)

config BR2_GCC_USE_SJLJ_EXCEPTIONS
	bool "Enable setjmp/longjmp exceptions?"
	help
	  For some platforms, proper stack unwinding works perfectly,
	  while other platforms must use setjmp/longjmp exceptions for
	  proper stack unwinding during exception handling.  Most people
	  can leave this set to n.

config BR2_EXTRA_GCC_CONFIG_OPTIONS
	string "Additional gcc options"
	default ""
	help
	  Any additional gcc configure options you may want to include....

config BR2_GCC_CROSS_FORTRAN
	bool "Fortran cross-compiler support"
	depends on !BR2_avr32
	help
	  Build a Fortran cross-compiler

config BR2_INSTALL_LIBGCJ
	bool "Build/install java compiler and libgcj?"
	depends on !BR2_avr32 && BR2_INSTALL_LIBSTDCPP
	help
	  Build/install java compiler and libgcj?

config BR2_INSTALL_OBJC
	bool "Build/install Objective-C compiler and runtime?"
	depends on !BR2_avr32
	help
	  Build/install Objective-C compiler and runtime?

config BR2_INSTALL_FORTRAN
	bool "Build/install Fortran compiler and runtime?"
	depends on !BR2_avr32
	select BR2_PACKAGE_LIBMPFR
	help
	  Build/install Fortran compiler and runtime?
	  Note that it is highly recommended NOT to use gfortran
	  from gcc older than 4.2.0

config BR2_GCC_SHARED_LIBGCC
	bool "Build/install a shared libgcc?"
	default y
	help
	  Build/install a shared libgcc library
```

## toolchain/kernel-headers/Config.in
```kconfig
# Choose the kernel headers to use for kernel-headers target. This is
# ignored if you are building your own kernel or using the system kernel.
#

comment "Kernel Header Options"

choice
	prompt "Kernel Headers"
	default BR2_KERNEL_HEADERS_2_6_31

	help
	  Select the version of kernel header files you wish to use.
	  You must select the correct set of header files to match
	  the kernel you intend to use on your target system.

	  For the snapshot, you have to provide the
	  linux-2.6.tar.bz2 tarball in your download dir.

	config BR2_KERNEL_HEADERS_2_6_24
		bool "Linux 2.6.24.x kernel headers"

	config BR2_KERNEL_HEADERS_2_6_28
		bool "Linux 2.6.28.x kernel headers"

	config BR2_KERNEL_HEADERS_2_6_29
		bool "Linux 2.6.29.x kernel headers"

	config BR2_KERNEL_HEADERS_2_6_30
		bool "Linux 2.6.30.x kernel headers"

	config BR2_KERNEL_HEADERS_2_6_31
		bool "Linux 2.6.31.x kernel headers"

	config BR2_KERNEL_HEADERS_SNAP
		bool "Linux 2.6 snapshot"

endchoice


config BR2_KERNEL_HEADERS_PATCH_DIR
	bool "Add additional headers from $(KERNEL_HEADERS_PATCH_DIR)"
	help
	  Apply additional kernel patches defined by KERNEL_HEADERS_PATCH_DIR
	  in your board directory.

config BR2_DEFAULT_KERNEL_HEADERS
	string
	default "2.6.24.7"	if BR2_KERNEL_HEADERS_2_6_24
	default "2.6.28.10"	if BR2_KERNEL_HEADERS_2_6_28
	default "2.6.29.6"	if BR2_KERNEL_HEADERS_2_6_29
	default "2.6.30.9"	if BR2_KERNEL_HEADERS_2_6_30
	default "2.6.31.6"	if BR2_KERNEL_HEADERS_2_6_31
	default "2.6"		if BR2_KERNEL_HEADERS_SNAP
```
